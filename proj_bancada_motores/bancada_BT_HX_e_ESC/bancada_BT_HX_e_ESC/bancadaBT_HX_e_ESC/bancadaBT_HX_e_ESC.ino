#include <ESP32Servo.h>

#include "BluetoothSerial.h"
#include "HX711.h"

#include <SPI.h>
#include <Wire.h>
#include <Adafruit_GFX.h>
#include <Adafruit_SSD1306.h>

#define SCREEN_WIDTH 128
#define SCREEN_HEIGHT 64
#define OLED_RESET     -1 // Reset pin # (or -1 if sharing Arduino reset pin)

Adafruit_SSD1306 display(SCREEN_WIDTH, SCREEN_HEIGHT, &Wire, OLED_RESET);

//baixar aplicativo "serial bluetooth terminal"

// 'EDRA_logo-ezgif', 128x64px
const unsigned char edra_logo [] PROGMEM = {
0x00, 0x00, 0x00, 0x00, 0x00, 0x00, 0x00, 0x00, 0x00, 0x00, 0x00, 0x00, 0x00, 0x00, 0x00, 0x00, 
0x00, 0x00, 0x00, 0x00, 0x00, 0x00, 0x00, 0x7f, 0xfe, 0x00, 0x00, 0x00, 0x00, 0x00, 0x00, 0x00, 
0x00, 0x00, 0x00, 0x00, 0x00, 0x00, 0x07, 0xff, 0xff, 0xe0, 0x00, 0x00, 0x00, 0x00, 0x00, 0x00, 
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0x00, 0x00, 0x00, 0x00, 0x00, 0x00, 0x00, 0x00, 0x80, 0x00, 0x00, 0x00, 0x00, 0x00, 0x00, 0x00
};


const byte numChars = 32;
char receivedChars[numChars];

int escspd = 0,
    esc_percent = 0,
    w = 0;

double corrente = 0.0,
       tensao = 0.0;
    
const int DTpin = 16,
          SCKpin = 4,
          escpin = 18;
          // pinos do oLED: SCL -> D22; SDA -> D21; (n precisa declarar no codigo)

float hxfactor = 0; //fator de calibracao*******

unsigned long previousMillis = 0;

const long intervalo = 10000;

Servo ESC;

HX711 carga;

BluetoothSerial serialBT;

void setup(){

  // SSD1306_SWITCHCAPVCC = generate display voltage from 3.3V internally
  if(!display.begin(SSD1306_SWITCHCAPVCC, 0x3C)) { 
    Serial.println(F("SSD1306 allocation failed"));
    for(;;); // Don't proceed, loop forever
  }
  
  display.clearDisplay();
  display.drawBitmap(1, 1, edra_logo, SCREEN_WIDTH, SCREEN_HEIGHT, 1);
  display.display();

  delay(5000);
  
  ESC.attach(escpin);
  ESC.writeMicroseconds(1000);

  carga.begin(DTpin, SCKpin);
  
  while(hxfactor == 0){ setCaliFactor(); delay(500); }
  
  carga.set_scale(hxfactor); //fator de calibracao - rodar codigo p/calibrar
  carga.tare(); // define o valor do 'peso 0' da balança
  
  carga.power_down();
  

  serialBT.begin("bancada_de_testes");

  delay(5000);

  serialBT.print("ESC em ");
      serialBT.print(esc_percent);
      serialBT.println("% da velocidade");
      serialBT.print("'peso' do motor: ");
      serialBT.print(w);
      serialBT.println(" (g)");
}

void loop(){
  
  unsigned long currentMillis = millis();

  if(currentMillis - previousMillis >= intervalo){
    previousMillis = currentMillis;

    carga.power_up();
    
    w = carga.get_units(5);

    serialBT.println("***PARA O CONTROLE DO MOTOR, DIGITE VALOR DE 0 A 100 (%)***");
    serialBT.println();
    serialBT.print("ESC em ");
    serialBT.print(esc_percent);
    serialBT.println("% da velocidade");
    serialBT.print("'peso' do motor: ");
    serialBT.print(w);
    serialBT.println(" (g)");
    serialBT.println();

    carga.power_down();
    drawData();

    escspd = 1000;
    esc_percent = 0;
  }

  set_escBT();

  ESC.writeMicroseconds(escspd);
  
  delay(20);
}


void set_escBT(){
  static byte i = 0;
  char endmarker = '\n';
  char rc;
  int recnum = 0;
  
  if (serialBT.available() > 0){
    rc = serialBT.read();

    if(rc!=endmarker){
      receivedChars[i] = rc;
      i++;

      if(i>=numChars){
        i = numChars - 1;
      }
    } else {
      receivedChars[i] = '\0';
      i = 0;
    }
  
  recnum = atoi(receivedChars);
  esc_percent = constrain(recnum, 0, 100);
  escspd = map(esc_percent, 0, 100, 1000, 2000);
  }
}

void setCaliFactor(){
  if(carga.is_ready()){

    display.clearDisplay();
    display.setTextSize(3);
    display.setTextColor(WHITE);
    display.setCursor(0,0);
    
    carga.set_scale();

    display.print("REMOVER PESOS DA BALANÇA");
    serialBT.println("Calibrando... remova todos os pesos da balança.");
    
    delay(6000);
    
    display.clearDisplay();
    
    carga.tare();

    display.print("COLOQUE PESO CONHECIDO\nSOBRE A BALANÇA");
    serialBT.println("Calibragem concluida. Agora, coloque um peso conhecido na balança.");

    delay(6000);
    
    display.clearDisplay();
    
    long reading = carga.get_units(10);

    serialBT.print("Resultado (anote esse numero): ");
    serialBT.println(reading);

    serialBT.println("Divida o resultado pelo valor do peso conhecido (em gramas) e insira no terminal.");

    display.println("RESULTADO:");
    display.println(reading);
    display.println("divida pelo peso conhecido (em g)");
    display.println();
    display.print("Insira o valor no terminal.");
    
    for(int j=0; j<1; ){
      
      static byte i = 0;
      char endmarker = '\n';
      char rc;
  
      if (serialBT.available() > 0){
        rc = serialBT.read();
    
        if(rc!=endmarker){
          receivedChars[i] = rc;
          i++;
    
          if(i>=numChars){
            i = numChars - 1;
          }
        } else {
          receivedChars[i] = '\0';
          i = 0;
        }
      }
      
      hxfactor = atof(receivedChars);

      j++;
    }
  } else { serialBT.println("HX711 not found");}
  
  delay(1000);
}

void drawData() {
  display.clearDisplay();

  display.setTextSize(2);
  display.setTextColor(WHITE);
  display.setCursor(0, 0);
  display.print("A: ");
  display.println(corrente);
  display.print("V: ");
  display.println(tensao);
  display.print("g: ");
  display.println(w);

  display.display();
  delay(2000);
}
